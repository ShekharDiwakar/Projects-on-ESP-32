#include <Arduino.h>
#include <U8g2lib.h>
#include <Wire.h>



//initializing OLED object
U8G2_SSD1306_128X64_NONAME_F_HW_I2C u8g2(U8G2_R0, /* clock=*/ SCL, /* data=*/ SDA, /* reset=*/ U8X8_PIN_NONE);  

//mapping pins to words
#define joystick_x 32
#define joystick_y 33
#define joystick_select 34

const uint8_t lbird_16 [][32] = {{0x00, 0x00, 0x10, 0x00, 0x6F, 0x40, 0x83, 0x60, 0x02, 0x59, 0x02, 0x47, 0x04, 0xE0, 0x04, 0x40, 0x04, 0x60, 0x04, 0x30, 0x08, 0x20, 0x10, 0x18, 0x30, 0x18, 0xC0, 0xE0, 0x00, 0x3F, 0x00, 0x00},
{0x00, 0x00, 0x30, 0x00, 0xCF, 0x00, 0x83, 0x00, 0x02, 0x01, 0x02, 0x01, 0x04, 0x01, 0x04, 0x02, 0x04, 0x02, 0x08, 0x04, 0x08, 0x04, 0x10, 0x08, 0x20, 0x78, 0xC0, 0xE0, 0x00, 0x1F, 0x00, 0x00},
{0x00, 0x00, 0x71, 0x00, 0x8F, 0x00, 0x83, 0x00, 0x02, 0x01, 0x82, 0x01, 0xC4, 0x01, 0x34, 0x02, 0x1E, 0x02, 0x04, 0x02, 0x38, 0x04, 0xF0, 0x0D, 0xE0, 0xF7, 0xC0, 0x71, 0x00, 0x0E, 0x00, 0x00},
{0x00, 0x00, 0x7A, 0x00, 0x87, 0x00, 0x83, 0x00, 0x02, 0x01, 0x82, 0x01, 0xE4, 0x01, 0x24, 0x02, 0xC4, 0x02, 0x88, 0x04, 0x88, 0x07, 0x10, 0x0E, 0x60, 0xF0, 0x80, 0x6B, 0x00, 0x14, 0x00, 0x00},
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{0x00, 0x00, 0x00, 0x00, 0x7F, 0x00, 0x87, 0x00, 0x02, 0x01, 0x02, 0x01, 0x02, 0x01, 0x04, 0x02, 0x04, 0x02, 0x04, 0x04, 0x08, 0x04, 0x10, 0x0C, 0x10, 0x18, 0x60, 0xE0, 0x80, 0x3F, 0x00, 0x00},
};


const uint8_t rbird_16 [][32] = {{0x00, 0x00, 0x00, 0x08, 0x02, 0xF6, 0x06, 0xC1, 0x9A, 0x40, 0xE2, 0x40, 0x07, 0x20, 0x02, 0x20, 0x06, 0x20, 0x0C, 0x20, 0x04, 0x10, 0x18, 0x08, 0x18, 0x0C, 0x07, 0x03, 0xFC, 0x00, 0x00, 0x00},
{0x00, 0x00, 0x00, 0x0C, 0x00, 0xF3, 0x00, 0xC1, 0x80, 0x40, 0x80, 0x40, 0x80, 0x20, 0x40, 0x20, 0x40, 0x20, 0x20, 0x10, 0x20, 0x10, 0x10, 0x08, 0x1E, 0x04, 0x07, 0x03, 0xF8, 0x00, 0x00, 0x00},
{0x00, 0x00, 0x00, 0x8E, 0x00, 0xF1, 0x00, 0xC1, 0x80, 0x40, 0x80, 0x41, 0x80, 0x23, 0x40, 0x2C, 0x40, 0x78, 0x40, 0x20, 0x20, 0x1C, 0xB0, 0x0F, 0xEF, 0x07, 0x8E, 0x03, 0x70, 0x00, 0x00, 0x00},
{0x00, 0x00, 0x00, 0x5E, 0x00, 0xE1, 0x00, 0xC1, 0x80, 0x40, 0x80, 0x41, 0x80, 0x27, 0x40, 0x24, 0x40, 0x23, 0x20, 0x11, 0xE0, 0x11, 0x70, 0x08, 0x0F, 0x06, 0xD6, 0x01, 0x28, 0x00, 0x00, 0x00},
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{0x00, 0x00, 0x00, 0x00, 0x00, 0xFE, 0x00, 0xE1, 0x80, 0x40, 0x80, 0x40, 0x80, 0x40, 0x40, 0x20, 0x40, 0x20, 0x20, 0x20, 0x20, 0x10, 0x30, 0x08, 0x18, 0x08, 0x07, 0x06, 0xFC, 0x01, 0x00, 0x00},
};

int points = 0;

int user_x = 64;
int user_y = 32;

int in_x1;
int bird_x, bird_y;
bool bird_alive;
bool game_over = 0;
bool path_over = 0;
int move_x;

void setup() {
  // put your setup code here, to run once:

  Serial.begin(9600);
  //initialising oled
  u8g2.begin();


  //setting the pinmodes to get joystick inputs
  pinMode(joystick_x,INPUT);
  pinMode(joystick_y,INPUT);
  pinMode(joystick_select, INPUT);

  //u8g2.setBitmapMode(0);
  start_screen();
}

void loop() { 
}

void start_screen(){
  while(digitalRead(joystick_select) == HIGH){  
  u8g2.clearBuffer();
  u8g2.setFont(u8g2_font_ncenB14_tr);
  u8g2.drawStr(0,20,"DUCK HUNT");
  u8g2.setFont(u8g2_font_squeezed_b7_tr);
  u8g2.drawStr(15,50,"Press button to start");
  u8g2.sendBuffer();
  };
  game();
}

void end_screen(){
  Serial.println("END SCREEN");
  u8g2.clearBuffer();
  u8g2.setFont(u8g2_font_ncenB14_tr);
  u8g2.drawStr(10,20,"Game Over");
  u8g2.setFont(u8g2_font_squeezed_b7_tr);
  u8g2.drawStr(15,50,"Your points:");
  u8g2.setCursor(80, 50);
  u8g2.print(points);
  u8g2.sendBuffer();

  while(1);
}

void check_game_over(){
  Serial.print("Bird_alive: ");
  Serial.print(bird_alive);
  Serial.print("  ");
  Serial.print("path_over: ");
  Serial.print(path_over);
   Serial.print("  ");
   Serial.print("game_over: ");
  Serial.println(game_over);
if(bird_alive == 1 & path_over == 1)
 game_over =1;
}

void set_values(){
   in_x1 = random(1,3);
  if(in_x1 == 1){
    bird_x =0;
  }
  else{
    bird_x = 112;
  }
  bird_y = random(0,48); 
  bird_alive = 1;
  path_over = 0;
  Serial.println("NEW VALUES SET");
  Serial.print("in_x1: ");
  Serial.print(in_x1);
  Serial.print(" ");
  Serial.print("bird_x: ");
  Serial.print(bird_x);
  Serial.print(" ");
  Serial.print("bird_y: ");
  Serial.println(bird_y);
}

void game(){
 
set_values();

move_x = 5;
int i =0;


while(!game_over){
 Serial.print("Bird_x: ");
 Serial.print(bird_x);
 Serial.print("  ");
 Serial.print("Bird_y: ");
 Serial.println(bird_y);
 
  u8g2.clearBuffer();
 if(in_x1 ==1){
  u8g2.drawXBM(bird_x,bird_y,16,16,rbird_16[i]);
  bird_x = bird_x  + move_x; 
  if(bird_x > 130)
  {
    Serial.println("r_bird done");
    path_over = 1;
    check_game_over();
  }
 }
 else{
  u8g2.drawXBM(bird_x, bird_y,16,16,lbird_16[i]);
  bird_x = bird_x  - move_x;
   if(bird_x < -1)
  {
    Serial.println("l_bird done");
    path_over = 1;
    check_game_over();
  }
 }
 draw_circle();
 if(digitalRead(joystick_select) != HIGH){
 kill_bird(bird_x + 8, bird_y +8);
 }
 u8g2.sendBuffer();
 delay(100);
 
 i++;
 if ( i > 27){
  i =0;
 }
 check_game_over();
};

end_screen();
}

void draw_circle(){
    int change_x = analogRead(joystick_x);
    int change_y = analogRead(joystick_y);
    
    change_x = map(change_x, 0, 4095, -5, 5);
    change_y = map(change_y, 0, 4095, -5, 5);
    user_x = user_x -  2 *change_x;
    user_y = user_y + 2 * change_y;
    u8g2.drawCircle(user_x, user_y, 10, U8G2_DRAW_ALL);
}

void kill_bird(int d1, int d2){
int  dist_x = (d1 - user_x)* (d1 - user_x);
 int  dist_y = (d2 - user_y)* (d2 - user_y);
int   dist = sqrt(dist_x +dist_y);
  Serial.println(dist);
  if(dist <=10){
  Serial.println("dead");
  bird_alive = 0;
  points++;
  if(points %5 ==0){
    move_x++;
  }
  set_values();
  }
  else{
    Serial.println("alive");
  }
   
}
